## components/board_config/Kconfig.projbuild
```kconfig
menu "Board Selection"

    choice BOARD_TARGET
        prompt "Target board"
        default BOARD_LILYGO_T_CAMERA_PLUS
        help
            Select the hardware board. This choice sets CONFIG_BOARD_DATA_FILE
            to the corresponding boards/<board>.h data file, which is included
            by include/board.h at compile time.
            To add a new board, create boards/<new>.h and add an entry here.

        config BOARD_LILYGO_T_CAMERA_PLUS
            bool "LilyGo T-Camera Plus (ESP32, OV2640, WiFi, 8 MB quad PSRAM, ST7789 display)"

        config BOARD_AI_THINKER_ESP32_CAM
            bool "AI Thinker ESP32-CAM (ESP32, OV2640, WiFi, 4 MB PSRAM)"

        config BOARD_OLIMEX_ESP32_POE
            bool "Olimex ESP32-POE (ESP32, OV2640, Ethernet only, no PSRAM)"

    endchoice

    config BOARD_DATA_FILE
        string
        default "boards/lilygo_t_camera_plus.h" if BOARD_LILYGO_T_CAMERA_PLUS
        default "boards/ai_thinker_esp32_cam.h"  if BOARD_AI_THINKER_ESP32_CAM
        default "boards/olimex_esp32_poe.h"      if BOARD_OLIMEX_ESP32_POE
        help
            Path to the board data header file, relative to the include path
            configured in components/board_config/CMakeLists.txt.
            Consumed by include/board.h via: #include CONFIG_BOARD_DATA_FILE

    config BOARD_HAS_WIFI
        bool
        default y if BOARD_LILYGO_T_CAMERA_PLUS || BOARD_AI_THINKER_ESP32_CAM
        default n

    config BOARD_HAS_ETHERNET
        bool
        default y if BOARD_OLIMEX_ESP32_POE
        default n

endmenu
```

## components/sensor_registry/Kconfig.projbuild
```kconfig
menu "Sensor Selection"

    choice SENSOR_TARGET
        prompt "Target sensor"
        default SENSOR_OV2640
        help
            Select the camera sensor. This choice sets CONFIG_SENSOR_DATA_FILE
            to the corresponding sensors/<sensor>.h data file, which is included
            by include/sensor_caps.h at compile time.
            To add a new sensor, create sensors/<new>.h and add an entry here.

        config SENSOR_OV2640
            bool "OV2640 (OmniVision, 2 MP, DVP, embedded JPEG encoder)"

        config SENSOR_OV5640
            bool "OV5640 (OmniVision, 5 MP, DVP)"

    endchoice

    config SENSOR_DATA_FILE
        string
        default "sensors/ov2640.h" if SENSOR_OV2640
        default "sensors/ov5640.h" if SENSOR_OV5640
        help
            Path to the sensor data header file, relative to the include path
            configured in components/sensor_registry/CMakeLists.txt.
            Consumed by include/sensor_caps.h via: #include CONFIG_SENSOR_DATA_FILE

endmenu
```

## components/status_indicator/Kconfig.projbuild
```kconfig
menu "Status Indicator"

    config STATUS_INDICATOR_HAS_DISPLAY
        bool "Board has a display (status shown via display_manager)"
        default n

    config STATUS_INDICATOR_LED_PIN
        int "LED GPIO pin number (-1 = no LED)"
        depends on !STATUS_INDICATOR_HAS_DISPLAY
        default -1
        range -1 48

    config STATUS_INDICATOR_LED_ACTIVE_LOW
        bool "LED is active-low (logic is inverted)"
        depends on !STATUS_INDICATOR_HAS_DISPLAY
        default n

endmenu
```

## components/wifi_manager/Kconfig.projbuild
```kconfig
menu "WiFi Manager"
    config WIFI_MANAGER_ENABLED
        bool "Enable WiFi Manager"
        default y if BOARD_HAS_WIFI
        default n
        help
            Enable the WiFi manager component. Disable on boards without
            WiFi hardware (e.g. Olimex ESP32-POE when used in Ethernet-only mode).
endmenu
```

## sdkconfig.defaults
```kconfig
# Shared sdkconfig defaults — applies to all boards.
# Board-specific settings (PSRAM mode, flash size, board selection) are
# in sdkconfig.defaults.<board-name> fragments.

# PSRAM
CONFIG_SPIRAM_USE_MALLOC=y
CONFIG_SPIRAM_MALLOC_ALWAYSINTERNAL=16384

# WiFi
CONFIG_ESP_WIFI_ENABLED=y
CONFIG_ESP_WIFI_STATIC_RX_BUFFER_NUM=10
CONFIG_ESP_WIFI_DYNAMIC_RX_BUFFER_NUM=32
CONFIG_ESP_WIFI_TX_BUFFER_TYPE=1
CONFIG_ESP_WIFI_DYNAMIC_TX_BUFFER_NUM=32

# CPU frequency
CONFIG_ESP_DEFAULT_CPU_FREQ_MHZ_240=y

# Main task stack — increase for RTSP workload
CONFIG_ESP_MAIN_TASK_STACK_SIZE=8192

# Log level
CONFIG_LOG_DEFAULT_LEVEL_INFO=y

# Per-module log levels (ESPCAMFW-12)
CONFIG_LOG_MAXIMUM_LEVEL_VERBOSE=y

# Note: ESP-IDF does not support per-tag compile-time level selection via sdkconfig.
# Per-module runtime level control is implemented via sys_log_set_level().

# Interrupt Watchdog -- protects against ISR hangs
CONFIG_ESP_INT_WDT=y
CONFIG_ESP_INT_WDT_TIMEOUT_MS=800
# PSRAM access in ISR can take up to ~300 ms; 800 ms gives safe margin
```

## sdkconfig.defaults.ai-thinker-esp32-cam
```kconfig
# Board selection
CONFIG_BOARD_AI_THINKER_ESP32_CAM=y

# Sensor selection
CONFIG_SENSOR_OV2640=y

# Status indicator
CONFIG_STATUS_INDICATOR_HAS_DISPLAY=n
CONFIG_STATUS_INDICATOR_LED_PIN=33
CONFIG_STATUS_INDICATOR_LED_ACTIVE_LOW=y

# PSRAM: 4 MB quad-SPI
CONFIG_SPIRAM=y
CONFIG_SPIRAM_MODE_QUAD=y

# Flash: 4 MB
CONFIG_ESPTOOLPY_FLASHSIZE_4MB=y
```

## sdkconfig.defaults.lilygo-t-camera-plus
```kconfig
# Board selection
CONFIG_BOARD_LILYGO_T_CAMERA_PLUS=y

# Sensor selection
CONFIG_SENSOR_OV2640=y

# Status indicator: display present
CONFIG_STATUS_INDICATOR_HAS_DISPLAY=y

# PSRAM: 8 MB quad-SPI (ESP32, not S3 — no OCT/OPI mode)
CONFIG_SPIRAM=y
CONFIG_SPIRAM_MODE_QUAD=y
CONFIG_SPIRAM_SPEED_80M=y

# Flash: 4 MB
CONFIG_ESPTOOLPY_FLASHSIZE_4MB=y
```

## sdkconfig.defaults.olimex-esp32-poe
```kconfig
# Board selection
CONFIG_BOARD_OLIMEX_ESP32_POE=y

# Status indicator
CONFIG_STATUS_INDICATOR_HAS_DISPLAY=n
CONFIG_STATUS_INDICATOR_LED_PIN=-1
CONFIG_STATUS_INDICATOR_LED_ACTIVE_LOW=n

# No PSRAM on Olimex ESP32-POE
CONFIG_SPIRAM=n
CONFIG_ESPTOOLPY_FLASHSIZE_4MB=y
```
